## br2-external/Config.in
```kconfig
# top-level Config.in for br2-external
source "$BR2_EXTERNAL_MANGOPI_MQPRO_PATH/package/custom-rtl8723ds/Config.in"
```

## br2-external/board/mangopi/mqpro/Config.in
```kconfig
config BR2_TARGET_UBOOT_CUSTOM
    bool "Use custom U-Boot config"
    default y

config BR2_LINUX_KERNEL_CUSTOM
    bool "Use custom kernel config"
    default y
```

## br2-external/package/custom-rtl8723ds/Config.in
```kconfig
config BR2_PACKAGE_CUSTOM_RTL8723DS
    bool "RTL8723DS Wi-Fi Driver"
    depends on BR2_LINUX_KERNEL
    help
      Build and install the RTL8723DS Wi-Fi kernel module

comment "rtl8723ds needs a Linux kernel to be built"
    depends on !BR2_LINUX_KERNEL
```
